## drivers/amlogic/fd628/Kconfig
```kconfig
#
# Input core configuration
#



config AML_FD628
	tristate "Amlogic fd628 device surport"
	default n
	help
	  Say Y here if you want to use the FD628.
```

## drivers/amlogic/hdmi_gpio/Kconfig
```kconfig
#
# Input core configuration
#



config AML_HDMI_GPIO
	tristate "Amlogic HDMI GPIO DECT device surport"
	default n
	help
	  Say Y here if you want to use the hdmi gpio dect.
```

## drivers/amlogic/input/vfd/Kconfig
```kconfig
#
# VFD configuration
#

config VFD_ENABLE
	tristate "VFD support"
	default n
	help
	  Say Y here if you want to use the amlogic VFD control.

	  To compile this driver as a module, choose M here: the
	  module will be called .

#config VFD_NO_KEY_INPUT
#	tristate "VFD not keyscan"
#	default n
#	help
#	  not use vfd for keyscan
#
#config VFD_SM1628
#	depends on VFD_ENABLE
#	bool "SM1628 MCU support"
#	default n
#	help
#	  Use SM1628 MCU as controller
#config VFD_CT1642
#        depends on VFD_ENABLE
#        bool "CT1642 MCU support"
#        default n
#        help
#          Use CT1642 MCU as controller
#
#config VFD_FD650
#	depends on VFD_ENABLE
#	bool "FD650 MCU support"
#	default n
#	help
#	  Use FD650 MCU as controller

config VFD_FD628SW
	depends on VFD_ENABLE
	bool "FD628 MCU support"
	default n
	help
	  Use fd628 MCU as controller
```

## drivers/amlogic/ledlight/Kconfig
```kconfig
#support amlogic external module power control

menuconfig AMLOGIC_LEDLIGHT
	tristate "Amlogic Led Light"
	default n
	help
	  Amlogic Led Light
```
